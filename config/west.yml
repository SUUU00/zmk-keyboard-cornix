## config/west.yml
```yaml
manifest:
  remotes:
    - name: zmkfirmware
      url-base: https://github.com/zmkfirmware
    - name: hitsmaxft
      url-base: https://github.com/hitsmaxft
    - name: urob
      url-base: https://github.com/urob
    - name: janpfischer
      url-base: https://github.com/janpfischer
  projects:
    - name: zmk
      remote: zmkfirmware
      revision: abb64ba316c29caddc49727ca2cac2f0ed5970c7 # ←【重要】ZMK本体を安定版に固定
      clone-depth: 1
      import:
        file: app/west.yml
    - name: zmk-helpers
      remote: urob
      revision: main
      clone-depth: 1
    - name: zmk-rgbled-widget
      remote: hitsmaxft
      revision: main
      clone-depth: 1
    - name: zmk-dongle-display
      remote: hitsmaxft
      revision: 379d012702feeb85d7ff89879408283b763dece7 # ←【重要】ここも正常なバージョンに固定
      clone-depth: 1
    - name: zmk-dongle-screen
      remote: janpfischer
      revision: main
      clone-depth: 1
  self:
    path: config
```
